## package/openssl/Config.in
```kconfig
menu "Configuration"
	depends on PACKAGE_libopenssl

config OPENSSL_ENGINE_CRYPTO
	bool
	prompt "Crypto acceleration support"
	
config OPENSSL_THREADS
	bool
	prompt "Threading support"
	default n
	select PACKAGE_libpthread
	
config OPENSSL_ENGINE_DIGEST
	bool
	depends OPENSSL_ENGINE_CRYPTO
	prompt "Digests acceleration support"

endmenu
```
